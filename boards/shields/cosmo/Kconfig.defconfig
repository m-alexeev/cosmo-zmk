## boards/shields/cosmo/Kconfig.defconfig
```kconfig
if SHIELD_SPLITKB_COSMO_LEFT

config ZMK_KEYBOARD_NAME
    default "Cosmo"

config ZMK_SPLIT_ROLE_CENTRAL
  default y

endif # SHIELD_SPLITKB_COSMO_LEFT

if SHIELD_SPLITKB_COSMO_LEFT || SHIELD_SPLITKB_COSMO_RIGHT

config BT
    default y

config ZMK_BLE
    default y

config ZMK_SPLIT
    default y

config ZMK_SPLIT_BLE
    default y


endif # SHIELD_SPLITKB_COSMO_LEFT || SHIELD_SPLITKB_COSMO_RIGHT
```

## boards/shields/cosmo/Kconfig.shield
```kconfig
config SHIELD_SPLITKB_COSMO_LEFT
    def_bool $(shields_list_contains,cosmo_left)

config SHIELD_SPLITKB_COSMO_RIGHT
    def_bool $(shields_list_contains,cosmo_right)
```

## config/west.yml
```yaml
manifest:
  defaults:
    revision: v0.3
  remotes:
    - name: zmkfirmware
      url-base: https://github.com/zmkfirmware
    - name: cosmo-zmk
      url-base: https://github.com/m-alexeev/
  projects:
    - name: zmk
      remote: zmkfirmware
      import: app/west.yml
    - name: cosmo-zmk
      remote: cosmo-zmk
      revision: main
  self:
    path: config
```
